## config/west.yml
```yaml
manifest:
  defaults:
    revision: v0.3
  remotes:
    - name: zmkfirmware
      url-base: https://github.com/zmkfirmware
    # Used for zmk-helpers (ZMK_LAYER, ZMK_HOLD_TAP, ZMK_TAP_DANCE, ZMK_COMBO macros, key labels)
    - name: urob
      url-base: https://github.com/urob
    # Used for Zen display patches (e-ink full refresh, invert, layer status widget tweaks)
    - name: caksoylar
      url-base: https://github.com/caksoylar
    # Additional modules containing boards/shields/custom code can be listed here as well
    # See https://docs.zephyrproject.org/3.2.0/develop/west/manifest.html#projects
  projects:
    - name: zmk
      remote: caksoylar
      revision: caksoylar/zen-v1+v2
      import: app/west.yml
    - name: zmk-helpers
      remote: urob
      revision: main
  self:
    path: config
```
